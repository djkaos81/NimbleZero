## external/configs/nz_minimal_defconfig
```kconfig
BR2_aarch64=y
BR2_cortex_a53=y
BR2_OPTIMIZE_2=y
BR2_TOOLCHAIN_EXTERNAL=y
BR2_TOOLCHAIN_EXTERNAL_BOOTLIN=y
BR2_TOOLCHAIN_EXTERNAL_BOOTLIN_AARCH64_GLIBC_STABLE=y
BR2_DOWNLOAD_FORCE_CHECK_HASHES=y
BR2_GLOBAL_PATCH_DIR="$(BR2_EXTERNAL_NZ_PATH)/patches"
BR2_TARGET_GENERIC_HOSTNAME="nimblezero"
BR2_TARGET_GENERIC_ISSUE="NimbleZero"
BR2_SYSTEM_DHCP=""
BR2_ROOTFS_OVERLAY="$(BR2_EXTERNAL_NZ_PATH)/board/cardputerzero/rootfs-overlay"
BR2_ROOTFS_POST_BUILD_SCRIPT="$(BR2_EXTERNAL_NZ_PATH)/board/cardputerzero/post-build.sh"
BR2_ROOTFS_POST_IMAGE_SCRIPT="$(BR2_EXTERNAL_NZ_PATH)/board/cardputerzero/post-image.sh"
BR2_LINUX_KERNEL=y
BR2_LINUX_KERNEL_CUSTOM_TARBALL=y
BR2_LINUX_KERNEL_CUSTOM_TARBALL_LOCATION="$(call github,raspberrypi,linux,0b41724521c9adf5399409d02aece6c1df0a4432)/linux-0b41724521c9adf5399409d02aece6c1df0a4432.tar.gz"
BR2_LINUX_KERNEL_DEFCONFIG="bcm2711"
BR2_LINUX_KERNEL_CONFIG_FRAGMENT_FILES="$(BR2_EXTERNAL_NZ_PATH)/board/cardputerzero/linux.fragment"
BR2_LINUX_KERNEL_DTS_SUPPORT=y
BR2_LINUX_KERNEL_INTREE_DTS_NAME="broadcom/bcm2710-rpi-cm0 broadcom/bcm2710-rpi-zero-2-w broadcom/bcm2710-rpi-3-b"
BR2_LINUX_KERNEL_NEEDS_HOST_OPENSSL=y
BR2_PACKAGE_BUSYBOX_SHOW_OTHERS=y
BR2_PACKAGE_RPI_FIRMWARE=y
BR2_PACKAGE_RPI_FIRMWARE_BOOTCODE_BIN=y
BR2_PACKAGE_RPI_FIRMWARE_VARIANT_PI=y
BR2_PACKAGE_RPI_FIRMWARE_CONFIG_FILE="$(BR2_EXTERNAL_NZ_PATH)/board/cardputerzero/config.txt"
BR2_PACKAGE_RPI_FIRMWARE_CMDLINE_FILE="$(BR2_EXTERNAL_NZ_PATH)/board/cardputerzero/cmdline.txt"
BR2_PACKAGE_BRCMFMAC_SDIO_FIRMWARE_RPI=y
BR2_PACKAGE_BRCMFMAC_SDIO_FIRMWARE_RPI_BT=y
BR2_PACKAGE_BRCMFMAC_SDIO_FIRMWARE_RPI_WIFI=y
BR2_PACKAGE_NZ_WIFI_NVRAM=y
BR2_PACKAGE_WIRELESS_REGDB=y
BR2_PACKAGE_KMOD=y
BR2_PACKAGE_KMOD_TOOLS=y
BR2_PACKAGE_DROPBEAR=y
BR2_PACKAGE_WPA_SUPPLICANT=y
BR2_PACKAGE_WPA_SUPPLICANT_NL80211=y
BR2_PACKAGE_WPA_SUPPLICANT_CLI=y
BR2_PACKAGE_WPA_SUPPLICANT_PASSPHRASE=y
BR2_PACKAGE_I2C_TOOLS=y
BR2_PACKAGE_EVTEST=y
BR2_PACKAGE_ALSA_UTILS=y
BR2_PACKAGE_ALSA_UTILS_AMIXER=y
BR2_PACKAGE_ALSA_UTILS_APLAY=y
BR2_PACKAGE_E2FSPROGS=y
BR2_PACKAGE_E2FSPROGS_RESIZE2FS=y
BR2_TARGET_ROOTFS_EXT2=y
BR2_TARGET_ROOTFS_EXT2_4=y
BR2_TARGET_ROOTFS_EXT2_SIZE="256M"
BR2_PACKAGE_HOST_DOSFSTOOLS=y
BR2_PACKAGE_HOST_GENIMAGE=y
BR2_PACKAGE_HOST_MTOOLS=y
BR2_PACKAGE_NZ_DRIVERS=y
BR2_PACKAGE_NZ_DIAG=y
BR2_TARGET_GENERIC_ROOT_PASSWD=""
BR2_ROOTFS_USERS_TABLES="$(BR2_EXTERNAL_NZ_PATH)/board/cardputerzero/users.table"
BR2_ROOTFS_POST_FAKEROOT_SCRIPT="$(BR2_EXTERNAL_NZ_PATH)/board/cardputerzero/post-fakeroot.sh"
BR2_TARGET_ROOTFS_EXT2_MKFS_OPTIONS="-O ^64bit,^orphan_file -E lazy_itable_init=0,lazy_journal_init=0"
BR2_PACKAGE_SUDO=y
BR2_PACKAGE_IW=y
BR2_TARGET_TZ_INFO=y
BR2_TARGET_TZ_ZONELIST="default"
BR2_TARGET_LOCALTIME="Etc/UTC"
BR2_PACKAGE_BUSYBOX_CONFIG_FRAGMENT_FILES="$(BR2_EXTERNAL_NZ_PATH)/board/cardputerzero/busybox.fragment"
BR2_ROOTFS_DEVICE_CREATION_DYNAMIC_MDEV=y
BR2_TARGET_GENERIC_GETTY=n
```

## external/package/dpkg/Config.in
```kconfig
config BR2_PACKAGE_DPKG
	bool "dpkg (Debian package manager, C tools only)"
	depends on BR2_USE_MMU
	select BR2_PACKAGE_LIBMD
	select BR2_PACKAGE_ZLIB
	select BR2_PACKAGE_XZ
	select BR2_PACKAGE_BZIP2
	select BR2_PACKAGE_ZSTD
	select BR2_PACKAGE_TAR
	help
	  The real dpkg from Debian (same upstream version as Debian
	  trixie): dpkg, dpkg-deb, dpkg-query, dpkg-divert,
	  dpkg-statoverride, dpkg-trigger, dpkg-split and
	  update-alternatives.  The Perl development scripts
	  (dpkg-dev) are not installed.

	  https://wiki.debian.org/Teams/Dpkg
```

## external/package/nz-compat/Config.in
```kconfig
config BR2_PACKAGE_NZ_COMPAT
	bool "nz-compat (M5Stack package compatibility layer)"
	select BR2_PACKAGE_DPKG
	help
	  Makes unmodified M5Stack .deb packages installable and
	  runnable on this Buildroot system: seeds the dpkg database
	  with the firmware-provided runtime, protects firmware files
	  from dpkg, creates the UID 1000 user and installs the device
	  aliases the M5Stack software expects.

config BR2_PACKAGE_NZ_COMPAT_SHIMS
	bool "service shims for BusyBox init (Configuration A)"
	depends on BR2_PACKAGE_NZ_COMPAT
	depends on !BR2_INIT_SYSTEMD
	help
	  systemctl/loginctl shims and the nz-unit runner, for images
	  without systemd.
```

## external/package/nz-diag/Config.in
```kconfig
config BR2_PACKAGE_NZ_DIAG
	bool "nz-diag (keyboard-driven diagnostic frontend)"
	depends on BR2_LINUX_KERNEL
	help
	  Small fbdev/evdev diagnostic UI and hardware probe for the
	  Cardputer Zero: system status, expected-device checklist,
	  keyboard test, display test/benchmark and kernel log viewer.
	  Also provides "nz-diag --report" for headless use.
```

## external/package/nz-drivers/Config.in
```kconfig
config BR2_PACKAGE_NZ_DRIVERS
	bool "nz-drivers (M5Stack Cardputer Zero kernel drivers + overlays)"
	depends on BR2_LINUX_KERNEL
	help
	  Out-of-tree kernel modules, device-tree overlays and firmware
	  blobs for the M5Stack Cardputer Zero, built unmodified from
	  https://github.com/m5stack/m5stack-linux-dtoverlays :
	  ST7789V LCD (panel-mipi-dbi variant) + PWM backlight, TCA8418
	  keyboard, ES8389 codec + sound card, BQ27220 fuel gauge, M5IOE1
	  IO expander, power-fail handler, GPIO forwarder, BMI270 IMU and
	  BMM150 magnetometer.
```

## external/package/nz-launcher/Config.in
```kconfig
config BR2_PACKAGE_NZ_LAUNCHER
	bool "nz-launcher (native keyboard-first launcher + nzui header)"
	help
	  Small fbdev/evdev application launcher that lists freedesktop
	  .desktop entries (native apps and M5Stack app packages alike)
	  and manages one foreground application at a time.  Also
	  installs the nzui.h single-header UI layer into the SDK.
```

## external/package/nz-wifi-nvram/Config.in
```kconfig
config BR2_PACKAGE_NZ_WIFI_NVRAM
	bool "nz-wifi-nvram"
	depends on BR2_PACKAGE_BRCMFMAC_SDIO_FIRMWARE_RPI
	help
	  Board-specific CYW43439 NVRAM for the Raspberry Pi Compute Module 0
	  (Murata Type 1YN), taken from Raspberry Pi's firmware-nonfree
	  packaging, plus the "raspberrypi,0-compute-module" firmware names
	  brcmfmac looks for first.

	  Without it brcmfmac falls back to the generic 43439 NVRAM, which
	  differs in boardflags3; on the first hardware boot that combination
	  ended in "HT Avail timeout" and no wlan0.
```
